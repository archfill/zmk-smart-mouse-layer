## Kconfig
```kconfig
# Copyright (c) 2026 The ZMK Smart Mouse Layer Contributors
# SPDX-License-Identifier: MIT

config ZMK_SMART_MOUSE_LAYER
    bool "Smart mouse layer input processor"
    default y
    depends on ZMK_POINTING
    help
      Enables an input processor that activates a mouse layer after pointer
      movement exceeds a threshold and keeps it active for configured mouse
      behaviors.

config ZMK_BEHAVIOR_SMART_MOUSE_LAYER
    bool "Smart mouse layer lock behavior"
    default y
    depends on DT_HAS_ZMK_BEHAVIOR_SMART_MOUSE_LAYER_ENABLED
    depends on ZMK_SMART_MOUSE_LAYER
    help
      Enables the behavior used to toggle-lock, hold-lock or exit the smart
      mouse layer from a key.
```

## dts/bindings/behaviors/zmk,behavior-smart-mouse-layer.yaml
```yaml
description: Smart mouse layer lock behavior (toggle lock / hold lock / exit)

compatible: "zmk,behavior-smart-mouse-layer"

include: one_param.yaml

properties:
  input-processor:
    type: phandle
    required: true
    description: The smart mouse layer input processor node this behavior controls.

  layer:
    type: int
    required: true
    description: Layer index activated by the toggle / hold lock. Should match the layer passed to the input processor.
```

## dts/bindings/input_processors/zmk,input-processor-smart-mouse-layer.yaml
```yaml
# Copyright (c) 2026 The ZMK Smart Mouse Layer Contributors
# SPDX-License-Identifier: MIT

description: Input processor for threshold-gated smart mouse layer activation

compatible: "zmk,input-processor-smart-mouse-layer"

include: ip_two_param.yaml

properties:
  movement-threshold:
    type: int
    required: false
    default: 0
    description: Accumulated absolute X/Y movement required before the layer activates.

  require-prior-idle-ms:
    type: int
    required: false
    default: 0
    description: Time in milliseconds that must pass after the last keystroke before activation.

  keep-behaviors:
    type: phandles
    required: true
    description: Effective key behaviors that keep the smart mouse layer active.

  keep-keycodes:
    type: array
    required: false
    default: []
    description: Keycodes in binding parameters that keep the smart mouse layer active.

  transparent-behaviors:
    type: phandles
    required: true
    description: Behaviors that should be treated as transparent during effective binding lookup.

  click-window-after-move-ms:
    type: int
    required: false
    default: 0
    description: |
      If nonzero (together with or instead of click-window-after-click-ms), a press on a
      keep-behaviors position counts as a mouse click only when the last pointer movement was
      at most this many milliseconds ago. Otherwise the layer is deactivated and the key is
      resolved on the layers below. 0 disables the window.

  click-window-after-click-ms:
    type: int
    required: false
    default: 0
    description: |
      A keep-behaviors press also counts as a click when any keep-behaviors position was
      released at most this many milliseconds ago (double click, left then right click).
      0 disables this window.

  warm-reactivation-ms:
    type: int
    required: false
    default: 0
    description: |
      After the layer is deactivated by the inactivity timeout, for this many milliseconds the
      activation threshold is warm-movement-threshold instead of movement-threshold.
      0 disables warm reactivation.

  warm-movement-threshold:
    type: int
    required: false
    default: 0
    description: Accumulated X/Y movement required to re-activate the layer while warm.

  disable-auto-activate:
    type: boolean
    description: |
      If set, pointer movement never activates the layer. The layer is only entered through
      the smart mouse layer behavior (toggle / hold lock).

  exit-mode:
    type: string
    default: "auto"
    enum:
      - "auto"
      - "explicit"
    description: |
      "auto": the automatically entered layer exits on typing keys, the inactivity timeout and
      the click-window judgment. "explicit": no inactivity timeout, button keys always click,
      typing keys exit only if explicit-exit-on-typing is set; otherwise exit via the SML_EXIT
      behavior.

  explicit-exit-on-typing:
    type: boolean
    description: In exit-mode "explicit", a typing key exits the layer.

  toggle-exit-on-typing:
    type: boolean
    description: While toggle-locked, a typing key exits the layer (and clears the lock).

  keep-layer-bindings:
    type: boolean
    description: |
      Bindings found on the target layer (or above it) that are not keep-behaviors, such as
      macros or &mo, keep the layer active instead of being treated as typing keys.
```
